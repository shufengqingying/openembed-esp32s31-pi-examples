## esp-idf/demo/board_demo/components/lvgl_example/Kconfig.projbuild
```kconfig
menu "LVGL Example Configuration"

    config LVGL_EXAMPLE_ENABLE
        bool "Enable LVGL example component"
        default y
        help
            Enable this option to use the LVGL graphics library example component.
            If disabled, the component initialization function will do nothing.

    if LVGL_EXAMPLE_ENABLE

        config LVGL_EXAMPLE_TASK_PRIORITY
            int "LVGL task priority"
            range 1 25
            default 1
            help
                Priority of the LVGL task.
                Higher number means higher priority. Default is 3.

        config LVGL_EXAMPLE_TASK_STACK_SIZE
            int "LVGL task stack size (KB)"
            range 1 64
            default 16
            help
                Stack size in KB for the LVGL task.
                Default is 16KB.

        config LVGL_EXAMPLE_GPIO_PIN
            int "LVGL indicator GPIO pin number"
            range 0 61
            default 55
            help
                GPIO pin number to set high when LVGL demo is active.
                Default: GPIO55
    

    choice LVGL_EXAMPLE_UI_SELECTION
        prompt "LVGL UI Demo Selection"
        default LVGL_EXAMPLE_UI_IDF
        help
            Select which LVGL UI demo to run at startup.
            
            Option 1: IDF Default Demo
            - Uses the standard ESP-IDF LVGL demo (lvgl_demo_ui.c)
            - Located at: components/lvgl_example/lvgl_demo_ui.c
            - Always available, no additional configuration required.
            
            Option 2: EEZ Studio Generated UI
            - Uses UI generated by EEZ Studio graphical designer
            - Located at: components/eez_example/ui/ui.c
            - Requires EEZ Studio generated files to be present.
            
            Option 3: LVGL Official Demos
            - Uses LVGL's official demos (lv_demo_widgets, lv_demo_music, etc.)
            - IMPORTANT: Must enable demos in LVGL configuration first:
            Component config -> LVGL configuration -> Examples
            - If not enabled, falls back to IDF Default Demo.

        config LVGL_EXAMPLE_UI_IDF
            bool "IDF Default Demo (lvgl_demo_ui.c)"

        config LVGL_EXAMPLE_UI_EEZ
            bool "EEZ Studio Generated UI (ui.c)"

        config LVGL_EXAMPLE_UI_LVGL_DEMO
            bool "LVGL Official Demos (lv_demo_*.c)"
    endchoice

    choice EXAMPLE_LCD_BUFFER_MODE
        prompt "RGB LCD Buffer Mode"
        default EXAMPLE_USE_SINGLE_FB
        help
            Select the LCD buffer mode.

        config EXAMPLE_USE_SINGLE_FB
            bool "Use single frame buffer"
            help
                Allocate one frame buffer in the driver.
                Allocate one draw buffer in LVGL.

        config EXAMPLE_USE_DOUBLE_FB
            bool "Use double frame buffer"
            help
                Allocate two frame buffers in the driver.
                The frame buffers also work as ping-pong draw buffers in LVGL.

        config EXAMPLE_USE_BOUNCE_BUFFER
            bool "Use bounce buffer"
            help
                Allocate one frame buffer in the driver.
                Allocate two bounce buffers in the driver.
                Allocate one draw buffer in LVGL.
    endchoice

    choice EXAMPLE_LCD_DATA_LINES
        prompt "RGB LCD Data Lines"
        default EXAMPLE_LCD_DATA_LINES_16
        help
            Select the number of data lines of the RGB LCD.

        config EXAMPLE_LCD_DATA_LINES_16
            bool "16 data lines"

        config EXAMPLE_LCD_DATA_LINES_24
            bool "24 data lines"
    endchoice

    config EXAMPLE_LCD_DATA_LINES
        int
        default 16 if EXAMPLE_LCD_DATA_LINES_16
        default 24 if EXAMPLE_LCD_DATA_LINES_24

    menu "RGB LCD GPIO assignment"
        config EXAMPLE_LCD_VSYNC_GPIO
            int "VSYNC GPIO"
            range 0 61         
            default 45
            help
                GPIO pin number for VSYNC signal.

        config EXAMPLE_LCD_HSYNC_GPIO
            int "HSYNC GPIO"
            range 0 61         
            default 44
            help
                GPIO pin number for HSYNC signal.

        config EXAMPLE_LCD_DE_GPIO
            int "DE GPIO"
            range 0 61         
            default 43
            help
                GPIO pin number for DE signal.

        config EXAMPLE_LCD_PCLK_GPIO
            int "PCLK GPIO"
            range 0 61         
            default 50
            help
                GPIO pin number for PCLK signal.

        config EXAMPLE_LCD_DATA0_GPIO
            int "DATA0 GPIO"
            range 0 61         
            default 2
            help
                GPIO pin number for data bus[0].

        config EXAMPLE_LCD_DATA1_GPIO
            int "DATA1 GPIO"
            range 0 61         
            default 3
            help
                GPIO pin number for data bus[1].

        config EXAMPLE_LCD_DATA2_GPIO
            int "DATA2 GPIO"
            range 0 61         
            default 10
            help
                GPIO pin number for data bus[2].

        config EXAMPLE_LCD_DATA3_GPIO
            int "DATA3 GPIO"
            range 0 61         
            default 11
            help
                GPIO pin number for data bus[3].

        config EXAMPLE_LCD_DATA4_GPIO
            int "DATA4 GPIO"
            range 0 61         
            default 0
            help
                GPIO pin number for data bus[4].

        config EXAMPLE_LCD_DATA5_GPIO
            int "DATA5 GPIO"
            range 0 61         
            default 1
            help
                GPIO pin number for data bus[5].

        config EXAMPLE_LCD_DATA6_GPIO
            int "DATA6 GPIO"
            range 0 61         
            default 4
            help
                GPIO pin number for data bus[6].

        config EXAMPLE_LCD_DATA7_GPIO
            int "DATA7 GPIO"
            range 0 61         
            default 5
            help
                GPIO pin number for data bus[7].

        config EXAMPLE_LCD_DATA8_GPIO
            int "DATA8 GPIO"
            range 0 61         
            default 6
            help
                GPIO pin number for data bus[8].

        config EXAMPLE_LCD_DATA9_GPIO
            int "DATA9 GPIO"
            range 0 61         
            default 7
            help
                GPIO pin number for data bus[9].

        config EXAMPLE_LCD_DATA10_GPIO
            int "DATA10 GPIO"
            range 0 61         
            default 42
            help
                GPIO pin number for data bus[10].

        config EXAMPLE_LCD_DATA11_GPIO
            int "DATA11 GPIO"
            range 0 61         
            default 46
            help
                GPIO pin number for data bus[11].

        config EXAMPLE_LCD_DATA12_GPIO
            int "DATA12 GPIO"
            range 0 61         
            default 33
            help
                GPIO pin number for data bus[12].

        config EXAMPLE_LCD_DATA13_GPIO
            int "DATA13 GPIO"
            range 0 61         
            default 34
            help
                GPIO pin number for data bus[13].

        config EXAMPLE_LCD_DATA14_GPIO
            int "DATA14 GPIO"
            range 0 61         
            default 35
            help
                GPIO pin number for data bus[14].

        config EXAMPLE_LCD_DATA15_GPIO
            int "DATA15 GPIO"
            range 0 61         
            default 36
            help
                GPIO pin number for data bus[15].

        config EXAMPLE_LCD_DATA16_GPIO
            int "DATA16 GPIO"
            depends on EXAMPLE_LCD_DATA_LINES > 16
            range 0 61         
            help
                GPIO pin number for data bus[16].

        config EXAMPLE_LCD_DATA17_GPIO
            int "DATA17 GPIO"
            depends on EXAMPLE_LCD_DATA_LINES > 16
            range 0 61         
            help
                GPIO pin number for data bus[17].

        config EXAMPLE_LCD_DATA18_GPIO
            int "DATA18 GPIO"
            depends on EXAMPLE_LCD_DATA_LINES > 16
            range 0 61         
            help
                GPIO pin number for data bus[18].

        config EXAMPLE_LCD_DATA19_GPIO
            int "DATA19 GPIO"
            depends on EXAMPLE_LCD_DATA_LINES > 16
            range 0 61         
            help
                GPIO pin number for data bus[19].

        config EXAMPLE_LCD_DATA20_GPIO
            int "DATA20 GPIO"
            depends on EXAMPLE_LCD_DATA_LINES > 16
            range 0 61         
            help
                GPIO pin number for data bus[20].

        config EXAMPLE_LCD_DATA21_GPIO
            int "DATA21 GPIO"
            depends on EXAMPLE_LCD_DATA_LINES > 16
            range 0 61         
            help
                GPIO pin number for data bus[21].

        config EXAMPLE_LCD_DATA22_GPIO
            int "DATA22 GPIO"
            depends on EXAMPLE_LCD_DATA_LINES > 16
            range 0 61         
            help
                GPIO pin number for data bus[22].

        config EXAMPLE_LCD_DATA23_GPIO
            int "DATA23 GPIO"
            depends on EXAMPLE_LCD_DATA_LINES > 16
            range 0 61         
            help
                GPIO pin number for data bus[23].
    endmenu










    endif # LVGL_EXAMPLE_ENABLE

endmenu
```

## esp-idf/demo/board_demo/components/usb_msc_example/Kconfig.projbuild
```kconfig
menu "USB MSC Example Configuration"

    config USB_MSC_EXAMPLE_ENABLE
        bool "Enable USB MSC example component"
        default y
        help
            Enable this option to use the USB MSC (Mass Storage Class) example component.
            If disabled, the component initialization function will do nothing.

endmenu
```
