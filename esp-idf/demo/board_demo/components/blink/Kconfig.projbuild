## esp-idf/demo/board_demo/components/blink/Kconfig.projbuild
```kconfig
menu "Blink LED"

    orsource "$IDF_PATH/examples/common_components/env_caps/$IDF_TARGET/Kconfig.env_caps"

    config BLINK_ENABLE
        bool "Enable Blink LED configuration"
        default y
        help
            Enable all Blink LED related configurations.
            If disabled, all options below will be hidden.

    if BLINK_ENABLE

        choice BLINK_LED
            prompt "Blink LED type"
            default BLINK_LED_STRIP
            help
                Select the LED type. A normal level controlled LED or an addressable LED strip.
                The default selection is based on the Espressif DevKit boards.
                You can change the default selection according to your board.

            config BLINK_LED_GPIO
                bool "GPIO"
            config BLINK_LED_STRIP
                bool "LED strip"
        endchoice

        choice BLINK_LED_STRIP_BACKEND
            depends on BLINK_LED_STRIP
            prompt "LED strip backend peripheral"
            default BLINK_LED_STRIP_BACKEND_RMT if SOC_RMT_SUPPORTED
            default BLINK_LED_STRIP_BACKEND_SPI
            help
                Select the backend peripheral to drive the LED strip.

            config BLINK_LED_STRIP_BACKEND_RMT
                depends on SOC_RMT_SUPPORTED
                bool "RMT"
            config BLINK_LED_STRIP_BACKEND_SPI
                bool "SPI"
        endchoice

        config BLINK_GPIO
            int "Blink GPIO number"
            range 0 61
            default 60
            help
                GPIO number (IOxx) to blink on and off the LED.
                Some GPIOs are used for other purposes (flash connections, etc.) and cannot be used to blink.

        config BLINK_PERIOD
            int "Blink period in ms"
            range 10 3600000
            default 6000
            help
                Define the blinking period in milliseconds.

    endif # BLINK_ENABLE

endmenu
```

## esp-idf/demo/board_demo/components/button_input_example/Kconfig.projbuild
```kconfig
menu "Button Input Example Configuration"

    config BUTTON_INPUT_EXAMPLE_ENABLE
        bool "Enable button input example component"
        default y
        help
            Enable this option to use the button input example component.
            If disabled, the component initialization function will do nothing.

    if BUTTON_INPUT_EXAMPLE_ENABLE

        config BUTTON_INPUT_EXAMPLE_GPIO
            int "Boot button GPIO number"
            range 0 61
            default 61
            help
                GPIO number connected to the boot button.
                Range: 0-61. Default is 61 (usually BOOT button on many boards).

        config BUTTON_INPUT_EXAMPLE_TASK_PRIORITY
            int "Button test task priority"
            range 1 25
            default 1
            help
                Priority of the button input test task.
                Higher number means higher priority. Default is 1.

        config BUTTON_INPUT_EXAMPLE_TASK_STACK_SIZE
            int "Button test task stack size"
            default 4096
            help
                Stack size (in bytes) for the button input test task.
                Default is 4096 bytes (4KB).


        config BUTTON_INPUT_EXAMPLE_LONG_PRESS_MS
            int "Long press time threshold (ms)"
            range 100 3000
            default 400
            help
                Time threshold in milliseconds to distinguish between short press and long press.
                If the button is held down longer than this value, it is considered a long press.
                Range: 100-3000 ms. Default is 1000 ms (1 second).


    endif # BUTTON_INPUT_EXAMPLE_ENABLE

endmenu
```

## esp-idf/demo/board_demo/components/eth_example/Kconfig.projbuild
```kconfig
menu "Ethernet Example Configuration"

    config ETH_EXAMPLE_ENABLE
        bool "Enable Ethernet example component"
        default n
        help
            Enable this option to use the Ethernet (LAN8720) example component.
            If disabled, the component initialization function will do nothing.

    if ETH_EXAMPLE_ENABLE

        config ETH_EXAMPLE_PHY_ADDR
            int "LAN8720 PHY address"
            range 0 31
            default 0
            help
                PHY address of the LAN8720.
                Default: 0 (matching board_pins.h definition).

        config ETH_EXAMPLE_MDC_GPIO
            int "MDC GPIO number"
            range 0 61
            default 16
            help
                GPIO pin for MDC (Management Data Clock).
                Default: GPIO16 (matching board_pins.h definition).

        config ETH_EXAMPLE_MDIO_GPIO
            int "MDIO GPIO number"
            range 0 61
            default 17
            help
                GPIO pin for MDIO (Management Data I/O).
                Default: GPIO17 (matching board_pins.h definition).

        config ETH_EXAMPLE_RMII_CLK_GPIO
            int "RMII REF_CLK GPIO number"
            range 0 61
            default 13
            help
                GPIO pin for RMII reference clock (50MHz).
                Default: GPIO13 (matching board_pins.h definition).

        choice ETH_EXAMPLE_RMII_CLK_SOURCE
            prompt "RMII 50MHz clock source"
            default ETH_EXAMPLE_RMII_CLK_EXTERNAL
            help
                Select the source of the RMII 50MHz reference clock.

            config ETH_EXAMPLE_RMII_CLK_EXTERNAL
                bool "External 50MHz oscillator (PHY provides clock to ESP32)"
                help
                    The 50MHz clock is provided by an external oscillator or the PHY chip.
                    ESP32 receives the clock via RMII_REF_CLK pin.

            config ETH_EXAMPLE_RMII_CLK_INTERNAL
                bool "Internal 50MHz output (ESP32 generates clock for PHY)"
                help
                    ESP32 generates the 50MHz clock internally and outputs it to the PHY.
                    Use this mode if your board does not have an external 50MHz oscillator.
        endchoice

        config ETH_EXAMPLE_TX_EN_GPIO
            int "TX_EN GPIO number"
            range 0 61
            default 12
            help
                GPIO pin for RMII TX_EN.
                Default: GPIO12 (matching board_pins.h definition).

        config ETH_EXAMPLE_TXD0_GPIO
            int "TXD0 GPIO number"
            range 0 61
            default 8
            help
                GPIO pin for RMII TXD0.
                Default: GPIO8 (matching board_pins.h definition).

        config ETH_EXAMPLE_TXD1_GPIO
            int "TXD1 GPIO number"
            range 0 61
            default 9
            help
                GPIO pin for RMII TXD1.
                Default: GPIO9 (matching board_pins.h definition).

        config ETH_EXAMPLE_CRS_DV_GPIO
            int "CRS_DV GPIO number"
            range 0 61
            default 15
            help
                GPIO pin for RMII CRS_DV (Carrier Sense / Data Valid).
                Default: GPIO15 (matching board_pins.h definition).

        config ETH_EXAMPLE_RXD0_GPIO
            int "RXD0 GPIO number"
            range 0 61
            default 19
            help
                GPIO pin for RMII RXD0.
                Default: GPIO19 (matching board_pins.h definition).

        config ETH_EXAMPLE_RXD1_GPIO
            int "RXD1 GPIO number"
            range 0 61
            default 18
            help
                GPIO pin for RMII RXD1.
                Default: GPIO18 (matching board_pins.h definition).

        config ETH_EXAMPLE_PHY_RST_GPIO
            int "PHY Reset GPIO number"
            range 0 61
            default 14
            help
                GPIO pin for PHY hardware reset.
                Default: GPIO14 (matching board_pins.h definition).

        config ETH_EXAMPLE_TASK_PRIORITY
            int "Ethernet initialization task priority"
            range 1 25
            default 4
            help
                Priority of the Ethernet initialization task.
                Higher number means higher priority.

    endif # ETH_EXAMPLE_ENABLE

endmenu
```
